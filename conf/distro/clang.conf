## conf/distro/clang.conf
```bitbake
DISTRO_USE_toolchain_clang = "1"
MACHINE_CC_PROG   = "clang"
MACHINE_OBJC_PROG = "clang"
MACHINE_CXX_PROG  = "clang++"
MACHINE_CFLAGS   += "-Qunused-arguments -Wno-gnu"
MINGW32_LDFLAGS = ""
# Temp hack
MINGW32_LDFLAGS:HOST_LIBC_mingw = "-Wl,--allow-multiple-definition"
MACHINE_LDFLAGS:>machine = "${MINGW32_LDFLAGS}"
MACHINE_CXXFLAGS += "-Qunused-arguments -Wno-gnu"
CFLAGS_OPT_SPEED  = "-O2 -fexpensive-optimizations -fomit-frame-pointer"
```

## conf/distro/linphone-full-debug.conf
```bitbake
require conf/distro/linphone-full.conf

INHIBIT_PACKAGE_STRIP = "1"
DISTRO_USE_bellesip_debug = "1"
DISTRO_USE_linphone_debug = "1"
DISTRO_USE_debug = "1"
```

## conf/distro/linphone-full.conf
```bitbake
require conf/distro/core.conf

DISTRO_USE_linphone_assistant = "1"
DISTRO_USE_nls = "1"
OECONF_STATIC_glib_machine = "0"

DISTRO_USE_rootfs_archive_formats = "tar"
DISTRO_USE_rootfs_archive_tar_ext = "tar.gz"

BUILD_LDFLAGS:BUILD_KERNEL_darwin = "-Wl,-headerpad_max_install_names"
HOST_LDFLAGS:HOST_KERNEL_darwin = "-Wl,-headerpad_max_install_names"
TARGET_LDFLAGS:TARGET_KERNEL_darwin = "-Wl,-headerpad_max_install_names"
```

## conf/distro/linphone-webplugin-debug.conf
```bitbake
require conf/distro/core.conf

DARWIN_LDFLAGS = ""
DARWIN_LDFLAGS:BUILD_KERNEL_darwin = "-Wl,-headerpad_max_install_names"

BUILD_LDFLAGS:>native = "${DARWIN_LDFLAGS}"
TARGET_LDFLAGS:>machine = " -Wl,-rpath=VERYDUMMYRPATHINORDERTOCHANGEITAFTERAGAINVERYDUMMYRPATHINORDERTOCHANGEITAFTE"
HOST_LDFLAGS:>machine = " -Wl,-rpath=VERYDUMMYRPATHINORDERTOCHANGEITAFTERAGAINVERYDUMMYRPATHINORDERTOCHANGEITAFTE"

INHIBIT_PACKAGE_STRIP = "1"

DISTRO_USE_ffmpeg_free = "1"
DISTRO_USE_linphone_libopus = "0"
DISTRO_USE_linphone_zrtp = "0"
DISTRO_USE_linphone_assistant = "0"
DISTRO_USE_linphone_console = "0"
DISTRO_USE_linphone_debug = "1"
DISTRO_USE_linphone_gtk = "0"
DISTRO_USE_rootfs_archive_formats = "tar"
DISTRO_USE_rootfs_archive_tar_ext = "tar.gz"
```

## conf/machine/darwin-x86.conf
```bitbake
MACHINE_CPU              = "i686"
MACHINE_ARCH             = "mmx"
MACHINE_OS               = "darwin11"
MACHINE_VENDOR           = "apple"
MACHINE_USE_machine_libc = "none:0"

# Gcc
GCC_VERSION      = "5666.3"
```

## conf/machine/darwin-x86_64.conf
```bitbake
MACHINE_CPU              = "x86_64"
MACHINE_ARCH             = "sse3"
MACHINE_OS               = "darwin11"
MACHINE_VENDOR           = "apple"
MACHINE_USE_machine_libc = "none:0"

# Gcc
GCC_VERSION      = "5666.3"
```

## conf/machine/linux-x86.conf
```bitbake
MACHINE_CPU               = "i686"
MACHINE_ARCH              = "mmx"
MACHINE_OS                = "linux-gnu"
MACHINE_USE_machine_libc  = "glibc:2.13"
```

## conf/machine/linux-x86_64.conf
```bitbake
MACHINE_CPU               = "x86_64"
MACHINE_ARCH              = "sse3"
MACHINE_OS                = "linux-gnu"
MACHINE_USE_machine_libc  = "glibc:2.13"
```

## conf/machine/windows-x86.conf
```bitbake
MACHINE_CPU               = "i686"
MACHINE_ARCH              = "mmx"
MACHINE_OS                = "mingw32"
MACHINE_USE_machine_libc  = "mingw:2.0.7"
```

## conf/machine/windows-x86_64.conf
```bitbake
MACHINE_CPU               = "x86_64"
MACHINE_ARCH              = "mmx"
MACHINE_OS                = "mingw32"
MACHINE_USE_machine_libc  = "mingw:2.0.7"
```
